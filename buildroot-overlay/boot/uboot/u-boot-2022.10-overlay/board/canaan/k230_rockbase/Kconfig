## buildroot-overlay/boot/uboot/u-boot-2022.10-overlay/board/canaan/k230_rockbase/Kconfig
```kconfig
if TARGET_K230_ROCKBASE

config SYS_CPU
	default "k230"

config SYS_VENDOR
    default "canaan"

config SYS_BOARD
    default "k230_rockbase"

config SYS_CONFIG_NAME
    default "k230_evb"


config BOARD_SPECIFIC_OPTIONS # dummy
	def_bool y
	select RISCV_THEAD
choice
	prompt "ddr typy freq"
    default ROCKBASE_LPDDR3_2133

    config ROCKBASE_LPDDR3_2133
        bool  "Rockbase LPDDR3 2133"

    config ROCKBASE_V3_LPDDR4_2667
	    bool "Rockbase LPDDR4 2667"
        help
            "Rockbase LPDDR4 2667 training data"

    config ROCKBASE_V3_LPDDR4_3200
	    bool "Rockbase LPDDR4 3200"
        help
            "Rockbase LPDDR4 3200 training data"

    config ROCKBASE_LPDDR4_1600_WITHOUT_ODT
	    bool "Rockbase LPDDR4 1600 without ODT"
        help
            "Rockbase LPDDR4 1600 training data without ODT"
endchoice

config K230_ROCKBASE_LCD_RESET_GPIO
    int "Rockbase LCD reset GPIO"
    default 24

config K230_ROCKBASE_LCD_BACKLIGHT_GPIO
    int "Rockbase LCD backlight GPIO"
    default 25

config K230_ROCKBASE_DISPLAY_BG_COLOR
    hex "Rockbase U-Boot display background color"
    default 0x808000
    help
        K230 VO background color in YUV-packed format. 0x808000 is black.
endif
```

## buildroot-overlay/configs/k230_rockbase_defconfig
```kconfig
# K230 RockBase Board defconfig
# Independent RockBase board support

BR2_riscv=y
BR2_RISCV_ISA_RVC=y
BR2_RISCV_ISA_RVV=y
BR2_TOOLCHAIN_EXTERNAL=y
BR2_TOOLCHAIN_EXTERNAL_CUSTOM=y
BR2_TOOLCHAIN_EXTERNAL_PATH="/opt/toolchain/Xuantie-900-gcc-linux-6.6.0-glibc-x86_64-V3.0.2/"
BR2_TOOLCHAIN_EXTERNAL_CUSTOM_PREFIX="riscv64-unknown-linux-gnu"
BR2_TOOLCHAIN_EXTERNAL_HEADERS_6_6=y
BR2_TOOLCHAIN_EXTERNAL_CUSTOM_GLIBC=y
# BR2_TOOLCHAIN_EXTERNAL_INET_RPC is not set
BR2_TOOLCHAIN_EXTERNAL_CXX=y
BR2_TOOLCHAIN_EXTERNAL_FORTRAN=y
BR2_TOOLCHAIN_EXTERNAL_OPENMP=y
BR2_TARGET_OPTIMIZATION="-mcpu=c908v -mtune=c908 -mrvv-v0p10-compatible  -mrvv-auto-vectorize"
BR2_DL_DIR="$(TOPDIR)/../../dl"
BR2_GLOBAL_PATCH_DIR="$(TOPDIR)/../../buildroot-overlay/board/canaan/k230_rockbase/patches"
BR2_SYSTEM_DHCP="eth0"
BR2_ROOTFS_OVERLAY="board/canaan/k230_rockbase/rootfs_overlay"
BR2_ROOTFS_POST_BUILD_SCRIPT="board/canaan/k230_rockbase/post-build.sh"
BR2_ROOTFS_POST_IMAGE_SCRIPT="board/canaan/k230_rockbase/post-image.sh"
BR2_LINUX_KERNEL=y
BR2_LINUX_KERNEL_CUSTOM_GIT=y
BR2_LINUX_KERNEL_CUSTOM_REPO_URL="https://github.com/ruyisdk/linux-xuantie-kernel.git"
BR2_LINUX_KERNEL_CUSTOM_REPO_VERSION="7d4e1f444f461dbe3833bd99a4640e7b6c2cd529"
BR2_LINUX_KERNEL_DEFCONFIG="k230"
BR2_LINUX_KERNEL_CONFIG_FRAGMENT_FILES="board/canaan/k230_rockbase/fragment/linux.fragment board/canaan/k230_rockbase/fragment/linux.led_btn"
BR2_LINUX_KERNEL_DTS_SUPPORT=y
BR2_LINUX_KERNEL_INTREE_DTS_NAME="canaan/k230-rockbase-lcd canaan/k230-rockbase"
BR2_LINUX_KERNEL_NEEDS_HOST_OPENSSL=y
BR2_PACKAGE_LINUX_TOOLS_GPIO=y
BR2_PACKAGE_VO_INIT=y
BR2_PACKAGE_RGB_CYCLE=y
BR2_PACKAGE_RTL8189FS=y
BR2_PACKAGE_WPA_SUPPLICANT=y
BR2_PACKAGE_WPA_SUPPLICANT_WEXT=y
BR2_PACKAGE_WPA_SUPPLICANT_CLI=y
BR2_PACKAGE_WPA_SUPPLICANT_PASSPHRASE=y
BR2_PACKAGE_WIRELESS_TOOLS=y
BR2_PACKAGE_WIRELESS_TOOLS_LIB=y
BR2_PACKAGE_OPENSSH=y
BR2_PACKAGE_RSYNC=y
BR2_TARGET_ROOTFS_EXT2=y
BR2_TARGET_ROOTFS_EXT2_4=y
BR2_TARGET_ROOTFS_EXT2_SIZE="24G"
BR2_TARGET_ROOTFS_EXT2_RESBLKS=0
BR2_TARGET_ROOTFS_EXT2_MKFS_OPTIONS="-O ^64bit -b 4096"
# BR2_TARGET_ROOTFS_TAR is not set
BR2_PACKAGE_E2FSPROGS=y
BR2_PACKAGE_E2FSPROGS_RESIZE2FS=y
BR2_PACKAGE_CKPOOL=y
BR2_PACKAGE_BITCOIN=y
# BR2_PACKAGE_BITCOIN_WALLET is not set
BR2_PACKAGE_ZEROMQ=y
BR2_PACKAGE_BUSYBOX_CONFIG_FRAGMENT_FILES="board/canaan/k230_rockbase/fragment/busybox.fragment"
BR2_TARGET_OPENSBI=y
BR2_TARGET_OPENSBI_CUSTOM_VERSION=y
BR2_TARGET_OPENSBI_CUSTOM_VERSION_VALUE="1.4"
BR2_TARGET_OPENSBI_PLAT="generic"
# BR2_TARGET_OPENSBI_INSTALL_DYNAMIC_IMG is not set
BR2_TARGET_OPENSBI_LINUX_PAYLOAD=y
BR2_TARGET_OPENSBI_ADDITIONAL_VARIABLES="FW_TEXT_START=0"
BR2_TARGET_UBOOT=y
BR2_TARGET_UBOOT_BOARDNAME="k230_rockbase"
BR2_TARGET_UBOOT_CUSTOM_VERSION=y
BR2_TARGET_UBOOT_CUSTOM_VERSION_VALUE="2022.10"
BR2_PACKAGE_HOST_GENIMAGE=y
```

## buildroot-overlay/package/ai_demo/common/Config.in
```kconfig
config BR2_PACKAGE_COMMON
    bool "ai demo common"
    select BR2_PACKAGE_DISPLAY
    select BR2_PACKAGE_GSL_LITE
    select BR2_PACKAGE_OPENCV4
    help
        ai demo common code
```

## buildroot-overlay/package/bl616_sdio/Config.in
```kconfig
config BR2_PACKAGE_BL616_SDIO
	bool "BL616 SDIO WiFi host stack"
	depends on BR2_LINUX_KERNEL
	help
	  Bouffalo Lab BL616/BL618 SDIO host-router module and control tools.
```

## buildroot-overlay/package/ckpool/Config.in
```kconfig
config BR2_PACKAGE_CKPOOL
	bool "ckpool"
	help
	  ckpool is a high-performance Bitcoin mining pool server
	  by Con Kolivas.

	  https://github.com/ckolivas/ckpool
```

## buildroot-overlay/package/rgb_cycle/Config.in
```kconfig
config BR2_PACKAGE_RGB_CYCLE
	bool "rgb_cycle"
	select BR2_PACKAGE_DISPLAY

	help
	  RGB panel cycle test utility for Rockbase. It renders full-screen
	  red, green, and blue frames in a 1-second loop for LCD validation.
```

## buildroot-overlay/package/rockbase-geoip/Config.in
```kconfig
config BR2_PACKAGE_ROCKBASE_GEOIP
	bool "rockbase-geoip"
	select BR2_PACKAGE_LIBMAXMINDDB
	help
	  Offline GeoLite2-City IP geolocation lookup tool for Rockbase.
	  Reads IPs from stdin and prints one JSON object per line with
	  lat/lon/city/country. Used by rockbase_statusd (self geo) and
	  /api/geoip.cgi (peer map). The GeoLite2-City.mmdb data file is
	  provisioned separately due to MaxMind licensing.
```

## buildroot-overlay/package/rockbase_lcdui/Config.in
```kconfig
config BR2_PACKAGE_ROCKBASE_LCDUI
	bool "rockbase_lcdui"
	select BR2_PACKAGE_DISPLAY
	select BR2_PACKAGE_LVGL
	help
	  Rockbase onboard LCD UI for the Solo BTC Node appliance.
	  The UI uses LVGL with the K230 display library and renders in
	  an 800x480 landscape coordinate system.
```
